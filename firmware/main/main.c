/**
 * @file main.c
 * @brief Application entry point — full feature firmware.
 *
 * Architecture:
 *   1. monitor_init()        — task cycle-time instrumentation
 *   2. hw_hal_gpio_init()    — GPIO setup
 *   3. protocol_init()       — creates shared FreeRTOS command queue
 *   4. comms_uart_init()     — UART listener task (always on)
 *   5. comms_wifi_init()     — WiFi AP connect + TCP server (when enabled)
 *   6. webui_init()          — HTTP server (when WiFi is enabled)
 *   7. app_task              — dequeues commands, dispatches hardware, replies
 *
 * All transports share one FreeRTOS queue.
 * The monitor component is called by app_task at begin/end of every loop
 * iteration so EPICS can read TASK:APP:MIN/MAX/AVG in real time.
 *
 * Configuration:
 *   WiFi SSID, password, TCP port, LED GPIO come from sdkconfig.defaults
 *   which is generated by `make gen-config` from project.conf.
 */
#include "freertos/FreeRTOS.h"
#include "freertos/task.h"

#include "hw_hal.h"
#include "protocol.h"
#include "comms.h"
#include <esp_wifi.h>
#include <esp_netif.h>
#include <nvs_flash.h>
#include "monitor.h"
#include "utils.h"
#include "webui.h"

/* ---- Config from sdkconfig (generated by make gen-config) ---- */
#ifdef CONFIG_PROJECT_LED_GPIO
#  define LED_GPIO   CONFIG_PROJECT_LED_GPIO
#else
#  define LED_GPIO   2
#endif

#ifdef CONFIG_PROJECT_WIFI_SSID
#  define WIFI_SSID  CONFIG_PROJECT_WIFI_SSID
#else
#  define WIFI_SSID  "your_ssid"
#endif

#ifdef CONFIG_PROJECT_WIFI_PASSWORD
#  define WIFI_PASS  CONFIG_PROJECT_WIFI_PASSWORD
#else
#  define WIFI_PASS  "your_password"
#endif

#ifdef CONFIG_PROJECT_TCP_PORT
#  define TCP_CMD_PORT CONFIG_PROJECT_TCP_PORT
#else
#  define TCP_CMD_PORT 7070
#endif

#define FW_VERSION "1.1.0"

static const char *TAG = "APP";

static uint32_t s_app_cycle_ms = 100;

/* ======================================================================
 * Application Task
 * Dequeues commands from the shared protocol queue, dispatches to hw_hal,
 * monitors cycle time, and routes replies back to the originating transport.
 * ====================================================================== */
static void app_task(void *pvParameters) {
    QueueHandle_t  cmd_queue = (QueueHandle_t)pvParameters;
    protocol_cmd_t cmd;
    char           reply[64];

    UTILS_LOGI(TAG, "app_task running on core %d", xPortGetCoreID());

    while (1) {
        monitor_task_begin("APP");

        /* Periodically log IP for convenience */
        esp_netif_ip_info_t ip_info;
        esp_netif_t *netif = esp_netif_get_handle_from_ifkey("WIFI_STA_DEF");
        if (netif && esp_netif_get_ip_info(netif, &ip_info) == ESP_OK) {
            char ip_str[16];
            esp_ip4addr_ntoa(&ip_info.ip, ip_str, sizeof(ip_str));
            static uint32_t last_log = 0;
            if (esp_log_timestamp() - last_log > 10000) {
                UTILS_LOGI(TAG, "My IP: %s", ip_str);
                last_log = esp_log_timestamp();
            }
        }

        if (xQueueReceive(cmd_queue, &cmd, pdMS_TO_TICKS(s_app_cycle_ms)) == pdTRUE) {

            bool    success = true;
            int     ret_val = -1;

            switch (cmd.device) {


            /* ---- LED ---- */
            case DEVICE_LED:
                if (cmd.action == ACTION_SET) {
                    hw_hal_gpio_set(LED_GPIO, (bool)cmd.value);
                    UTILS_LOGI(TAG, "LED -> %s", cmd.value ? "ON" : "OFF");
                } else if (cmd.action == ACTION_GET) {
                    ret_val = (int)hw_hal_gpio_get(LED_GPIO);
                } else {
                    success = false;
                }
                break;

            /* ---- GPIO (generic) ---- */
            case DEVICE_GPIO:
                if (cmd.action == ACTION_SET) {
                    hw_hal_gpio_init_output((uint8_t)cmd.value);
                    hw_hal_gpio_set((uint8_t)cmd.value, (bool)cmd.value2);
                    UTILS_LOGI(TAG, "GPIO[%d] -> %d", cmd.value, cmd.value2);
                } else if (cmd.action == ACTION_GET) {
                    ret_val = (int)hw_hal_gpio_get((uint8_t)cmd.value);
                } else if (cmd.action == ACTION_DIR) {
                    if (cmd.value2 == 1) { /* IN */
                        hw_hal_gpio_init_input((uint8_t)cmd.value);
                        UTILS_LOGI(TAG, "GPIO[%d] -> INPUT", cmd.value);
                    } else { /* OUT */
                        hw_hal_gpio_init_output((uint8_t)cmd.value);
                        UTILS_LOGI(TAG, "GPIO[%d] -> OUTPUT", cmd.value);
                    }
                } else {
                    success = false;
                }
                break;


            /* ---- SYS ---- */
            case DEVICE_SYS:
                switch (cmd.action) {
                case ACTION_PING:
                    snprintf(reply, sizeof(reply), "PONG\n");
                    goto send_raw;
                case ACTION_STATUS:
                    snprintf(reply, sizeof(reply), "OK %llu\n",
                             (unsigned long long)monitor_get_uptime_ms());
                    goto send_raw;
                case ACTION_VERSION:
                    snprintf(reply, sizeof(reply), "%s\n", FW_VERSION);
                    goto send_raw;
                case ACTION_HEAP:
                    ret_val = (int)monitor_get_free_heap();
                    break;
                case ACTION_CYCLE:
                    if (cmd.value > 0) {
                        s_app_cycle_ms = (uint32_t)cmd.value;
                        UTILS_LOGI(TAG, "Cycle time set to %u ms", (unsigned int)s_app_cycle_ms);
                    }
                    break;
                case ACTION_RESET:

                    snprintf(reply, sizeof(reply), "OK\n");
                    if (cmd.response_fd == -1) comms_uart_send(reply);
                    else comms_wifi_send(cmd.response_fd, reply);
                    vTaskDelay(pdMS_TO_TICKS(100));
                    esp_restart();
                    break;
                default:
                    success = false;
                }
                break;

            /* ---- TASK ---- */
            case DEVICE_TASK: {
                uint32_t tmin = 0, tmax = 0, tavg = 0;
                switch (cmd.action) {
                case ACTION_LIST:
                    ret_val = (int)monitor_get_task_count();
                    break;
                case ACTION_GET:
                    if (monitor_get_stats(cmd.str_arg, &tmin, &tmax, &tavg)) {
                        snprintf(reply, sizeof(reply), "%lu %lu %lu\n",
                                 (unsigned long)tmin,
                                 (unsigned long)tmax,
                                 (unsigned long)tavg);
                        goto send_raw;
                    }
                    /* Log the bad name in hex to find hidden characters if it fails */
                    char hex[49] = {0};
                    for(int i=0; i<16 && cmd.str_arg[i]; i++) sprintf(hex+i*3, "%02X ", (uint8_t)cmd.str_arg[i]);
                    UTILS_LOGW(TAG, "TASK:GET failed for '%s' (hex: %s)", cmd.str_arg, hex);
                    success = false;
                    break;
                case ACTION_GETALL: {
                    /* Multi-line reply — send each task on its own line */
                    size_t n = monitor_get_task_count();
                    char taskname[MONITOR_NAME_LEN];
                    for (size_t i = 0; i < n; i++) {
                        if (monitor_get_task_name(i, taskname) &&
                            monitor_get_stats(taskname, &tmin, &tmax, &tavg)) {
                            snprintf(reply, sizeof(reply), "%s %lu %lu %lu\n",
                                     taskname,
                                     (unsigned long)tmin,
                                     (unsigned long)tmax,
                                     (unsigned long)tavg);
                            if (cmd.response_fd == -1) comms_uart_send(reply);
                            else comms_wifi_send(cmd.response_fd, reply);
                        }
                    }
                    goto next_cycle; /* no single terminal reply */
                }
                case ACTION_RESET:
                    monitor_reset_stats(cmd.str_arg[0] ? cmd.str_arg : NULL);
                    break;
                default:
                    success = false;
                }
                break;
            }

            /* ---- PWM ---- */
            case DEVICE_PWM:
                if (cmd.action == ACTION_CFG) {
                    hw_hal_pwm_init((uint8_t)cmd.value, (uint8_t)cmd.value2, (uint32_t)cmd.value3);
                    UTILS_LOGI(TAG, "PWM CH%d CFG: Pin %d Freq %d", cmd.value2, cmd.value, cmd.value3);
                } else if (cmd.action == ACTION_SET) {
                    hw_hal_pwm_set_duty((uint8_t)cmd.value, (uint32_t)cmd.value2);
                    UTILS_LOGI(TAG, "PWM CH%d Set Duty: %d", cmd.value, cmd.value2);
                } else {
                    success = false;
                }
                break;

            /* ---- Analog Input (AI) ---- */
            case DEVICE_AI:
                if (cmd.action == ACTION_CFG) {
                    hw_hal_adc_init((uint8_t)cmd.value);
                    UTILS_LOGI(TAG, "AI CFG: Pin %d", cmd.value);
                } else if (cmd.action == ACTION_GET) {
                    ret_val = (int)hw_hal_adc_read_mv((uint8_t)cmd.value);
                } else {
                    success = false;
                }
                break;

            /* ---- I2C ---- */
            case DEVICE_I2C:
                if (cmd.action == ACTION_CFG) {
                    hw_hal_i2c_init((uint8_t)cmd.value, (uint8_t)cmd.value2, (uint32_t)cmd.value3);
                    UTILS_LOGI(TAG, "I2C CFG: SDA %d SCL %d Speed %d", cmd.value, cmd.value2, cmd.value3);
                } else {
                    success = false;
                }
                break;

            /* ---- UART2 ---- */
            case DEVICE_UART2:
                if (cmd.action == ACTION_CFG) {
                    hw_hal_uart2_init((uint8_t)cmd.value, (uint8_t)cmd.value2, (uint32_t)cmd.value3);
                    UTILS_LOGI(TAG, "UART2 CFG: TX %d RX %d Baud %d", cmd.value, cmd.value2, cmd.value3);
                } else {
                    success = false;
                }
                break;

            /* ---- DEVICE_PIN (Phase 8) ---- */
            case DEVICE_PIN:
                if (cmd.action == ACTION_CFG) {
                    hw_hal_pin_cfg((uint8_t)cmd.value, (pin_role_t)cmd.value2);
                    UTILS_LOGI(TAG, "PIN %d CFG: Role %d", cmd.value, cmd.value2);
                } else {
                    success = false;
                }
                break;

            /* ---- DEVICE_DAC (Phase 8) ---- */
            case DEVICE_DAC:
                if (cmd.action == ACTION_CFG) {
                    hw_hal_dac_init((uint8_t)cmd.value);
                    UTILS_LOGI(TAG, "DAC CFG: Pin %d", cmd.value);
                } else if (cmd.action == ACTION_SET) {
                    hw_hal_dac_set_voltage((uint8_t)cmd.value, (uint8_t)cmd.value2);
                    UTILS_LOGI(TAG, "DAC %d Set: %d", cmd.value, cmd.value2);
                } else {
                    success = false;
                }
                break;


            default:
                success = false;
                UTILS_LOGW(TAG, "Unhandled device %d", cmd.device);
                break;
            }

            /* Format and send reply */
            protocol_format_response(reply, sizeof(reply), success, ret_val);

            send_raw:
            if (cmd.response_fd == -1) comms_uart_send(reply);
            else comms_wifi_send(cmd.response_fd, reply);
        }

        next_cycle:
        monitor_task_end("APP");
    }
}

/* ======================================================================
 * Application Entry Point
 * ====================================================================== */
void app_main(void) {
    UTILS_LOGI(TAG, "ESP32 EPICS Firmware v%s starting...", FW_VERSION);

    /* 1. Initialise monitoring */
    monitor_init();

    /* 2. Initialise hardware */
    hw_hal_gpio_init_output(LED_GPIO);
    hw_hal_init_all(); /* Restore NVS pin roles */

    /* 3. Create shared command queue */
    QueueHandle_t cmd_queue = protocol_init();

    /* 4. UART transport (always on) */
    comms_uart_init(cmd_queue);

    /* 5. WiFi transport */
    comms_wifi_cfg_t wifi_cfg = {
        .ssid     = WIFI_SSID,
        .password = WIFI_PASS,
    };
    comms_wifi_init(cmd_queue, &wifi_cfg);
    UTILS_LOGI(TAG, "WiFi transport enabled (TCP port %d)", TCP_CMD_PORT);

    /* 6. Web UI HTTP server */
    webui_init(cmd_queue);

    /* 7. Application dispatch task */
    xTaskCreate(app_task, "app_task", 6144, (void *)cmd_queue, 5, NULL);

    UTILS_LOGI(TAG, "All systems up. Awaiting commands.");
}
